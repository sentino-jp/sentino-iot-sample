## device/projects/common_components/network_transfer/Kconfig
```kconfig
menu "net_transfer"
	# CONFIG_SENTINO_IOT moved to common_components/sentino_iot_sdk/Kconfig
	# in Phase 2 of the layering refactor.

	config BK_WSS_TRANS
		bool "Enable Beken Websocket Transmit for AI"
		default n

	config VOLC_HTTP_STARTUP_AGENT
		bool "Enable Beken Websocket Transmit for AI"
		depends on BK_DEV_STARTUP_AGENT
		default y
	config BK_WSS_TRANS_NOPSRAM
		bool "Enable Websocket Transmit for AI without PSRAM"
		default n
endmenu
```

## device/projects/common_components/sentino_iot_sdk/Kconfig
```kconfig
menu "sentino_iot_sdk"
	config SENTINO_IOT
		bool "Enable Sentino IoT control plane (MQTT signalling + triple NVS)"
		default n
		help
			Pulls in the Sentino MQTT signalling layer, three-tuple NVS
			persistence, and the sentino_iot_engine that bridges MQTT-issued
			session params to the active RTC backend (Agora today, Volc
			planned). Independent of CONFIG_AGORA_IOT_SDK so future builds
			can pair Sentino with another RTC backend.
endmenu
```
